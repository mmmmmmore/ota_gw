## protocol/wifi_ap/Kconfig
```kconfig
menu "Wifi_Menu_Configuration"

 

    config WIFI_SOFTAP_SSID
        string "SoftAP SSID"
        default "ESP32-TEST"
        help
            SSID (network name) for the example to connect to.

    config WIFI_SOFTAP_PASSWORD
        string "SoftAP Password"
        default "niwenwoa"
        help
            WiFi password (WPA or WPA2) for the example to use.
    config ESP_WIFI_CHANNEL
        int "WiFi Channel"
        range 1 13
        default 1
        help
            WiFi channel (network channel) for the example to use.

    config ESP_MAX_STA_CONN
        int "Maximal STA connections"
        default 4
        help
            Max number of the STA connects to AP.

    config ESP_GTK_REKEYING_ENABLE
        bool "Enable GTK Rekeying"
        default y
        help
            Flag to enable GTK rekeying.

    config ESP_GTK_REKEY_INTERVAL
        int "GTK rekey interval"
        depends on ESP_GTK_REKEYING_ENABLE
        range 60 65535
        default 600
        help
            GTK rekeying interval in seconds.
endmenu
```
